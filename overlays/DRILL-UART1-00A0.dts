/*
 * Copyright (C) 2013 CircuitCo
 *
 * Virtual cape for UART1 on connector pins P9.24 P9.26
 *
 * This program is free software; you can redistribute it and/or modify
 * it under the terms of the GNU General Public License version 2 as
 * published by the Free Software Foundation.
 */

/* Modified for P420/407 Deep Drill WDT UART1 intarface
 * Boleslaw Mellerowicz 2017-5-1
 */

/dts-v1/;
/plugin/;

/ {
	compatible = "ti,beaglebone", "ti,beaglebone-black", "ti,beaglebone-green";

	// identification
	part-number = "DRILL-UART1";
	version = "00A0";

	// resources this cape uses
	exclusive-use =
		"P9.24",		// uart1_txd
		"P9.26",		// uart1_rxd
	//	"P9.19",		// uart1_rtsn	conflict with uart1_rtsn.i2c2_scl, i.e. the cape EEPROMS
	//	"P9.20",		// uart1_ctsn	conflict with uart1_ctsn.i2c2_sda, i.e. the cape EEPROMS

		"uart1";		// hardware ip used

	fragment@0 {
		target = <&am33xx_pinmux>;
		__overlay__ {
			bb_uart1_pins: pinmux_bb_uart1_pins {
				pinctrl-single,pins = <
					0x184 0x08 /* BONE_P9_24 (PIN_OUTPUT | MUX_MODE0) GPIO=15 $PINS=97 UART1_TXD // uart1_txd.uart1_txd */
					0x180 0x28 /* BONE_P9_26 (PIN_INPUT | MUX_MODE0)  GPIO=14 $PINS=96 UART1_RXD // uart1_rxd.uart1_rxd */
						   /* BONE_P9_19 (PIN_OUTPUT | MUX_MODE0)	// uart1_rtsn.uart1_rtsn */
						   /* BONE_P9_20 (PIN_INPUT | MUX_MODE0)	// uart1_ctsn.uart1_ctsn */
				>;
			};
		};
	};

	fragment@1 {
		target = <&uart1>;
		__overlay__ {
			status = "okay";
			pinctrl-names = "default";
			pinctrl-0 = <&bb_uart1_pins>;
		};
	};
};
