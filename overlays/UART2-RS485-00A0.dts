/*
 * Copyright 2015 Sebastian Jegerås
 *
 * This file is dual-licensed: you can use it either under the terms
 * of the GPL or the X11 license, at your option. Note that this dual
 * licensing only applies to this file, and not this project as a
 * whole.
 *
 *  a) This file is free software; you can redistribute it and/or
 *     modify it under the terms of the GNU General Public License as
 *     published by the Free Software Foundation; either version 2 of the
 *     License, or (at your option) any later version.
 *
 *     This file is distributed in the hope that it will be useful,
 *     but WITHOUT ANY WARRANTY; without even the implied warranty of
 *     MERCHANTABILITY or FITNESS FOR A PARTICULAR PURPOSE.  See the
 *     GNU General Public License for more details.
 *
 * Or, alternatively,
 *
 *  b) Permission is hereby granted, free of charge, to any person
 *     obtaining a copy of this software and associated documentation
 *     files (the "Software"), to deal in the Software without
 *     restriction, including without limitation the rights to use,
 *     copy, modify, merge, publish, distribute, sublicense, and/or
 *     sell copies of the Software, and to permit persons to whom the
 *     Software is furnished to do so, subject to the following
 *     conditions:
 *
 *     The above copyright notice and this permission notice shall be
 *     included in all copies or substantial portions of the Software.
 *
 *     THE SOFTWARE IS PROVIDED "AS IS", WITHOUT WARRANTY OF ANY KIND,
 *     EXPRESS OR IMPLIED, INCLUDING BUT NOT LIMITED TO THE WARRANTIES
 *     OF MERCHANTABILITY, FITNESS FOR A PARTICULAR PURPOSE AND
 *     NONINFRINGEMENT. IN NO EVENT SHALL THE AUTHORS OR COPYRIGHT
 *     HOLDERS BE LIABLE FOR ANY CLAIM, DAMAGES OR OTHER LIABILITY,
 *     WHETHER IN AN ACTION OF CONTRACT, TORT OR OTHERWISE, ARISING
 *     FROM, OUT OF OR IN CONNECTION WITH THE SOFTWARE OR THE USE OR
 *     OTHER DEALINGS IN THE SOFTWARE.
 */

/* Modified for Deep Drill P420/407
 * Sensor RS485 UART2 Interface 
 *  - Boleslaw Mellerowicz 2017-4-28
 */


/dts-v1/;
/plugin/;


/ {
	compatible = "ti,beaglebone", "ti,beaglebone-black";

	// identification
	part-number = "UART2-RS485";
	version = "00A0";

	// resources this cape uses
	exclusive-use =
		"P9.21",		// uart2_txd
		"P9.22",		// uart2_rxd
		"P9.18",		// uart2_de/re
		"gpio0_4",

		"uart2";		// hardware ip used

	fragment@0 {
		target = <&am33xx_pinmux>;
		__overlay__ {
			bb_uart2_pins: pinmux_bb_uart2_pins {
				pinctrl-single,pins = <
					
					0x154 0x09 /* BONE_P9_21 (PIN_OUTPUT | MUX_MODE1) 	    GPIO=3 $PINS=85 UART2_TXD  */
					0x150 0x29 /* BONE_P9_22 (PIN_INPUT  | MUX_MODE1) 	    GPIO=2 $PINS=84 UART4_RXD */
					0x158 0x07 /* BONE_P9_18 (PIN_OUTPUT_PULLDOWN | MUX_MODE7)  GPIO=4 $PINS=86 GPIO0_4 */
				>;
			};
		};
	};

	fragment@1 {
//		target = <&uart2>;
		target = <&uart3>;     /* really uart2 */

		__overlay__ {
			status = "okay";
			pinctrl-names = "default";
			pinctrl-0 = <&bb_uart2_pins>;
			//rs485-rts-delay = <0 0>;

			//rts-gpio = <&gpio0 4 1>; /*  GPIO_ACTIVE_HIGH>; */
			//rs485-rts-active-high;
			//linux,rs485-enabled-at-boot-time;
		};
	};
};
